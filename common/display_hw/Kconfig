## common/display_hw/Kconfig
```kconfig
menu "Display hardware (Waveshare 2.8C)"

    config DISPLAY_HW_BOUNCE_BUFFER_LINES
        int "RGB bounce buffer height in lines"
        default 20
        range 0 120
        help
            Two internal-RAM bounce buffers of 480 x N pixels are used to stream the PSRAM
            framebuffer to the RGB bus. 0 disables them, which is known to make the image
            drift with a 64 B data cache line and 80 MHz PSRAM.

    config DISPLAY_HW_TOUCH_USE_INTERRUPT
        bool "Read GT911 on its interrupt line (GPIO16)"
        default y
        help
            When enabled the LVGL adapter reads the touch controller only after an INT edge.
            Disable to poll it on every LVGL input cycle, as the previous port did.

    config DISPLAY_HW_TOUCH_RESET_WAIT_MS
        int "GT911 wait after reset release, in ms"
        default 200
        range 10 500
        help
            Time between releasing GT911 reset and releasing INT. 200 ms matches the previous
            board definition.

endmenu
```

## interface_board/components/twai_daemon/KConfig
```kconfig
menu "TWAI Daemon"
    config CAN_TX
        int "CAN Transceiver TX GPIO"
        default 39

    config CAN_RX
        int "CAN Transceiver RX GPIO"
        default 38
endmenu
```

## interface_board/main/Kconfig.projbuild
```kconfig
menu "Interface board configuration"

    menu "Runtime stats"
        config ENABLE_RUNTIME_STATS_OUTPUT
            bool "Enable runtime stats serial output"
            default false
            select FREERTOS_USE_TRACE_FACILITY
            select FREERTOS_USE_STATS_FORMATTING_FUNCTIONS
            select FREERTOS_VTASKLIST_INCLUDE_COREID
            select FREERTOS_GENERATE_RUN_TIME_STATS
            select FREERTOS_RUN_TIME_STATS_USING_ESP_TIMER
            help
                Enabling this will automatically configure FreeRTOS to support 
                vTaskList and vTaskGetRunTimeStats with Core ID inclusion.
    endmenu
    
    menu "Interrupt GPIOs"
        config BUTTON_IRQ_GPIO
            int "BUTTON interrupt GPIO"
            default 10
        config FULL_BEAMS_IRQ_GPIO
            int "Full/Hi beams interrupt GPIO"
            default 11
            
    endmenu

    menu "5V Control"
        config 5V_EN_GPIO
            int "5V enable GPIO"
            default 48
        config 5V_AUX_EN_GPIO
            int "5V Auxiliary enable GPIO"
            default 47
    endmenu
    
    menu "I²C configuration"
        config SDA_PIN
            int "SDA GPIO for I2C"
            default 3

        config SCL_PIN
            int "SCL GPIO for I2C"
            default 9

    endmenu

    menu "ADC and SMA configuration"
                
        config PRIMARY_ADC_ADDR
            hex "Hex address for primary ADC chip"
            default 0x48
            help
                Sets the default address for the ADC. 
                0x48 for a ADS1115 without address bits set.
        
        config SET_HIGH_CAL_GPIO
            int "GPIO to set high caliber sense resistor for channel A"
            default 15

        config FUEL_LEVEL_SENSE_ADC_CHANNEL
            int "ADC channel for the fuel level sensing"
            default 0
        
        config BATTERY_VOLT_SENSE_ADC_CHANNEL
            int "ADC channel for the battery voltage sensing"
            default 1

        # choice ADC_DATA_RATE
        #     prompt "Choose target conversion data rate"
        #     config ADS111X_DATA_RATE_8
        #         bool "ADS111X_DATA_RATE_8"
        #     config ADS111X_DATA_RATE_16
        #         bool "ADS111X_DATA_RATE_16"
        #     config ADS111X_DATA_RATE_128
        #         bool "ADS111X_DATA_RATE_128"
        # endchoice
        
        config ADC_TO_SMA_POLLING_RATE_MS
            int "Polling interval to add an element to the SMA"
            default 200
            help
                Keep it relative to the SMA size to increase filtering and lag or not.

        config SMA_0_SIZE
            int "Size of SMA filter for ADC 0"
            default 100
            help
                Multiply it by polling rate to get time window. E.g. 200ms at 100 elements -> 20s filtering.
            
        config SMA_1_SIZE
            int "Size of SMA filter for ADC 1"
            default 10
            help
                Multiply it by polling rate to get time window. E.g. 200ms at 100 elements -> 20s filtering.

        config SMA_2_SIZE
            int "Size of SMA filter for ADC 2"
            default 10
            help
                Multiply it by polling rate to get time window. E.g. 200ms at 100 elements -> 20s filtering.

        config SMA_3_SIZE
            int "Size of SMA filter for ADC 3"
            default 10
            help
                Multiply it by polling rate to get time window. E.g. 200ms at 100 elements -> 20s filtering.
    endmenu

    menu "Debug messages"
        config ENABLE_DEBUG_MSG
            bool "Enable debug messages"
            default false
            help
                Enables debug message output. When disabled, all debug message types are also disabled.

        config DBG_SPEED_MSG
            bool "Enable speed debug messages"
            depends on ENABLE_DEBUG_MSG
            default false
            help
                Enables debug output for speed-related messages.

        config DBG_RPM_MSG
            bool "Enable RPM debug messages"
            depends on ENABLE_DEBUG_MSG
            default false
            help
                Enables debug output for RPM-related messages.

        config DBG_COOL_MSG
            bool "Enable coolant debug messages"
            depends on ENABLE_DEBUG_MSG
            default false
            help
                Enables debug output for coolant-related messages.

        config DBG_ADC_MSG
            bool "Enable ADC debug messages"
            depends on ENABLE_DEBUG_MSG
            default false
            help
                Enables debug output for ADC-related messages.
    endmenu

    menu "IO Expander configuration"

        config EXP_INT_PIN
            int "Interrupt pin for primary expander"
            default 7
            help
                Interrupt pin for the primary expander. Might be reversed logic!

        config USE_EXPANDER_INTERRUPT
            bool "Whether or not to use the expander interrupt to be more reactive"
            default true
            help
                This might create core panics. Use wisely.

        config INTERRUPT_DEBOUNCE_US
            depends on USE_EXPANDER_INTERRUPT
            int "Debounce time for expander interrupt, in microseconds"
            default 2000

        config PRIMARY_IO_EXPANDER_ADDRESS
            hex "Default hex address for primary IO Expander"
            default 0x20
            help
                Sets the default address value for the primary GPIO expander. 
                0x20 for a TCA9555 with A0->A2 = 0.

    endmenu

    menu "MCPWM configuration"
        config PWM_DETECT_TIMEOUT
            int "Timeout in ms for which 0Hz and 0% will be declared for a PWM signal"
            default 1000

        config LOOP_LOG_MCPWM
            bool "Read MCPWM values in main loop."
            default false

        config COOLANT_PWM_CAP_GPIO
            int "GPIO for the capture of the coolant PWM"
            default 6

        config RPM_PWM_CAP_GPIO
            int "GPIO for the capture of the RPM pulses"
            default 4

        config SPEED_PWM_CAP_GPIO
            int "GPIO for the capture of the speed PWM"
            default 5 
        config MCPWM_CAP_TIMER_RESOLUTION
            int "Resolution in Hz applied to the capture timer"
            default 100000
    endmenu

    menu "Display control"
        menu "Left Display"
            config LD_GP0_IO
                int "Display boot GPIO"
                default 21
            
            config LD_ALIVE_IO
                int "Display alive signal GPIO"
                default 12 
            
            config LD_TXD_IO
                int "Display TXD GPIO"
                default 13
            
            config LD_RXD_IO
                int "Display RXD GPIO"
                default 14
            

        endmenu
        menu "Right Display"
            config RD_GP0_IO
                int "Display boot GPIO"
                default 40
            
            config RD_ALIVE_IO
                int "Display alive signal GPIO"
                default 2 
            
            config RD_TXD_IO
                int "Display TXD GPIO"
                default 42
            
            config RD_RXD_IO
                int "Display RXD GPIO"
                default 41
            
                
        endmenu
        
    endmenu

endmenu
```

## left_screen/main/Kconfig.projbuild
```kconfig
menu "Display Application"
    

    config ENABLE_RUNTIME_STATS_OUTPUT
        bool "Enable runtime stats serial output"
        default false
        select FREERTOS_USE_TRACE_FACILITY
        select FREERTOS_USE_STATS_FORMATTING_FUNCTIONS
        select FREERTOS_VTASKLIST_INCLUDE_COREID
        select FREERTOS_GENERATE_RUN_TIME_STATS
        select FREERTOS_RUN_TIME_STATS_USING_ESP_TIMER
        help
            Enabling this will automatically configure FreeRTOS to support 
            vTaskList and vTaskGetRunTimeStats with Core ID inclusion.


    choice DISPLAY_SIDE
        prompt "Select the side on which the display is mounted"

        config RIGHT_SIDE_DISPLAY
            bool "Right Display Board"
            
        config LEFT_SIDE_DISPLAY
            bool "Left Display Board"
                
        
    endchoice

    config DATA_REFRESH_INTERVAL
        int "Milliseconds between refreshes of LVGL objects based on CAN data"
        default 25 
        range 5 100

    config OTA_BLOCK_SIZE
        int "0-255. block transmissions to prevent buffer overrun"
        default 255
        range 0 255

    config OTA_SEPARATION_TIME_MS
        int "0-255 ms separation time between CAN frames."
        default 1
        range 0 255

    config SLOW_BLINK_INTERVAL_MS
        int "Milliseconds for slow blink interval"
        default 300
        range 300 1000
    
    config FAST_BLINK_INTERVAL_MS
        int "Milliseconds for fast blink interval"
        default 100
        range 100 300
    menu "LVGL task"
        config LVGL_TASK_CORE_ID
            int "Core the LVGL task is pinned to (-1 for no affinity)"
            default 1
            range -1 1
            help
                Keep LVGL on core 1 so the CAN tasks on core 0 are not delayed by rendering.

        config LVGL_TASK_PRIORITY
            int "LVGL task priority"
            default 2
            range 1 24

        config LVGL_TASK_STACK_SIZE
            int "LVGL task stack size in bytes"
            default 12288
            range 4096 65536

        config LVGL_TICK_PERIOD_MS
            int "LVGL tick period in ms"
            default 2
            range 1 10

        config LVGL_TASK_MAX_DELAY_MS
            int "Maximum delay between two LVGL timer runs, in ms"
            default 500
            range 5 1000
    endmenu
endmenu
```

## right_screen/components/twai_daemon/Kconfig
```kconfig
menu "TWAI Daemon"
    config CAN_TX
        int "CAN Transceiver TX GPIO"
        default 39

    config CAN_RX
        int "CAN Transceiver RX GPIO"
        default 38

    config CAN_TX_POLLING_RATE_MS
        int "TX Queue polling interval in ms"
        default 5 

    config CAN_RX_POLLING_RATE_MS
        int "RX Queue polling interval in ms"
        default 5 
endmenu
```

## right_screen/main/Kconfig.projbuild
```kconfig
menu "Display Application"
    

    config ENABLE_RUNTIME_STATS_OUTPUT
        bool "Enable runtime stats serial output"
        default false
        select FREERTOS_USE_TRACE_FACILITY
        select FREERTOS_USE_STATS_FORMATTING_FUNCTIONS
        select FREERTOS_VTASKLIST_INCLUDE_COREID
        select FREERTOS_GENERATE_RUN_TIME_STATS
        select FREERTOS_RUN_TIME_STATS_USING_ESP_TIMER
        help
            Enabling this will automatically configure FreeRTOS to support 
            vTaskList and vTaskGetRunTimeStats with Core ID inclusion.


    choice DISPLAY_SIDE
        prompt "Select the side on which the display is mounted"

        config RIGHT_SIDE_DISPLAY
            bool "Right Display Board"
            
        config LEFT_SIDE_DISPLAY
            bool "Left Display Board"
                
        
    endchoice

    config DATA_REFRESH_INTERVAL
        int "Milliseconds between refreshes of LVGL objects based on CAN data"
        default 25 
        range 5 100

    config OTA_BLOCK_SIZE
        int "0-255. block transmissions to prevent buffer overrun"
        default 255
        range 0 255

    config OTA_SEPARATION_TIME_MS
        int "0-255 ms separation time between CAN frames."
        default 1
        range 0 255

    config SLOW_BLINK_INTERVAL_MS
        int "Milliseconds for slow blink interval"
        default 300
        range 300 1000
    
    config FAST_BLINK_INTERVAL_MS
        int "Milliseconds for fast blink interval"
        default 100
        range 100 300
endmenu
```
